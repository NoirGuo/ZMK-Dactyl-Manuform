## boards/shields/dactyl/Kconfig.defconfig
```kconfig
if SHIELD_DUO34_LEFT

config ZMK_KEYBOARD_NAME
    default "duo34"

config ZMK_SPLIT_ROLE_CENTRAL
    default y

endif

if SHIELD_DUO34_LEFT || SHIELD_DDUO34_RIGHT

config ZMK_SPLIT
    default y

endif
```

## boards/shields/duo34/Kconfig.shield
```kconfig
# Copyright (c) 2020 Noir Guo
# SPDX-License-Identifier: MIT

config SHIELD_DUO34_LEFT
    def_bool $(shields_list_contains,duo34_left)

config SHIELD_DUO34_RIGHT
    def_bool $(shields_list_contains,duo34_right)
```
