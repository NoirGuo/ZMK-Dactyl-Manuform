/*
 * Copyright (c) 2020 Pete Johanson
 *
 * SPDX-License-Identifier: MIT
 */

#include "duo34.dtsi"

&kscan0 {
    col-gpios
        = <&gpio0 18 GPIO_ACTIVE_HIGH>
        , <&gpio0 15 GPIO_ACTIVE_HIGH>
        , <&gpio1 14 GPIO_ACTIVE_HIGH>
        , <&gpio1 16 GPIO_ACTIVE_HIGH>
        , <&gpio1 10 GPIO_ACTIVE_HIGH>
        ;

};
